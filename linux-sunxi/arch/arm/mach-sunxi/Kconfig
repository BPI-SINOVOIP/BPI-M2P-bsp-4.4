## linux-sunxi/arch/arm/mach-sunxi/Kconfig
```kconfig
if ARCH_SUNXI

choice
	prompt "Select the architecture of SoC"
	default ARCH_SUN8I
	help
	  Select the architecture for SoC
	  sunxi
	  `-- sun8i ----- Cortex-A7 based Family SoCs

config ARCH_SUN8I
	bool "Allwinner A7 smp SoCs"
	select ARM_GIC
	select CPU_V7
	select HAVE_SMP
	select HAVE_ARM_ARCH_TIMER
	select SUN4I_TIMER
	select MIGHT_HAVE_CACHE_L2X0
	select PINCTRL
	select PINCTRL_SUNXI
	select ARCH_REQUIRE_GPIOLIB
	select COMMON_CLK
	select CLKDEV_LOOKUP
	select CLKSRC_MMIO
	select CLKSRC_OF
	select GENERIC_CLOCKEVENTS
	select GENERIC_IRQ_CHIP
	select SPARSE_IRQ
	select GENERIC_ALLOCATOR
	help
	  Allwinner A7 smp SoCs(sun8i)
endchoice

# Select the wafer with sun8i

if ARCH_SUN8I
choice
	prompt "Select the wafer with arch sun8i"
	default ARCH_SUN8IW11
	help
	  Select the wafer with arch sun8i

config ARCH_SUN8IW11
        bool "Allwinner sun8iw11 SoCs"
	select HAVE_UNSTABLE_SCHED_CLOCK
        help
          Allwinner sun8iw11 SoCs

config ARCH_SUN8IW12
        bool "Allwinner sun8iw12 SoCs"
        help
          Allwinner sun8iw12 SoCs
config ARCH_SUN8IW15
        bool "Allwinner sun8iw15 SoCs"
        help
          Allwinner sun8iw15 SoCs
config ARCH_SUN8IW7
        bool "Allwinner sun8iw7 SoCs"
        help
          Allwinner sun8iw7 SoCs
endchoice
endif

# Select the SoC with specific arch and wafer

if ARCH_SUN8IW11
choice
	prompt "Select the SoC with wafer sun8iw11"
	default ARCH_SUN8IW11P1
	help
	 Select the SoC with wafer sun8iw11

config ARCH_SUN8IW11P1
	bool "Allwinner sun8iw11p1 SoC"
	help
	  Allwinner sun8iw11p1 SoC
endchoice
endif

if ARCH_SUN8IW12
choice
	prompt "Select the SoC with wafer sun8iw12"
	default ARCH_SUN8IW12P1
	help
	 Select the SoC with wafer sun8iw12

config ARCH_SUN8IW12P1
	bool "Allwinner sun8iw12p1 SoC"
	help
	  Allwinner sun8iw12p1 SoC
endchoice
endif

if ARCH_SUN8IW15
choice
	prompt "Select the SoC with wafer sun8iw15"
	default ARCH_SUN8IW15P1
	help
	 Select the SoC with wafer sun8iw15

config ARCH_SUN8IW15P1
	bool "Allwinner sun8iw15p1 SoC"
	help
	  Allwinner sun8iw15p1 SoC
endchoice
endif

if ARCH_SUN8IW7
choice
	prompt "Select the SoC with wafer sun8iw7"
	default ARCH_SUN8IW7P1
	help
	 Select the SoC with wafer sun8iw7

config ARCH_SUN8IW7P1
	bool "Allwinner sun8iw7p1 SoC"
	help
	  Allwinner sun8iw7p1 SoC
endchoice
endif
# Select the board between FPGA and EVB

choice
	prompt "Allwinner development Board"
	depends on ARCH_SUNXI
	default FPGA_V4_PLATFORM

config FPGA_V4_PLATFORM
       bool "FPGAv4 board"
       help
         Support for Allwinner's FPGAv4 board

config FPGA_V7_PLATFORM
       bool "FPGAv7 board"
       help
         Support for Allwinner's FPGAv4 board

config EVB_PLATFORM
       bool "EVB board"
       help
         Support for Allwinner's EVB board
endchoice

config SUNXI_SOC_NAME
	string "The name of Sunxi SoC"
	default ""
	help
	  Used for /proc/cpuinfo and /sys/.../sysinfo.

endif
```

## linux-sunxi/drivers/char/sunxi-sram/Kconfig
```kconfig
#
# sram_a1 config.
#

config SUNXI_SRAM_A1
	tristate "sram_a1 for user space"
	depends on ARCH_SUN8IW12
	---help---
	 Say yes if you want to use the sram_a1 for user space; when this
	 configuration option is enabled, the user space can access SRAM
	 via mmap.
```

## linux-sunxi/drivers/char/sunxi_ir_cut/Kconfig
```kconfig
#
# Character device configuration
#


config SUNXI_IR_CUT
	tristate "support sunxi-ir-cut"
	default m
	help
	  Say Y here if you want to support sunxi-ir-cut device.

	  When in doubt, say "Y".
```

## linux-sunxi/drivers/cpuidle/Kconfig
```kconfig
menu "CPU Idle"

config CPU_IDLE
	bool "CPU idle PM support"
	default y if ACPI || PPC_PSERIES
	select CPU_IDLE_GOV_LADDER if (!NO_HZ && !NO_HZ_IDLE)
	select CPU_IDLE_GOV_MENU if (NO_HZ || NO_HZ_IDLE)
	help
	  CPU idle is a generic framework for supporting software-controlled
	  idle processor power management.  It includes modular cross-platform
	  governors that can be swapped during runtime.

	  If you're using an ACPI-enabled platform, you should say Y here.

if CPU_IDLE

config CPU_IDLE_MULTIPLE_DRIVERS
        bool

config CPU_IDLE_GOV_LADDER
	bool "Ladder governor (for periodic timer tick)"
	default y

config CPU_IDLE_GOV_MENU
	bool "Menu governor (for tickless system)"
	default y

config CPU_IDLE_USE_SUNXI_MENU_GOVERNOR
	bool "use allwinner sunxi governor based on menu governor."
	depends on CPU_IDLE_GOV_MENU
	default y
	help
	 Allwinner menu governor, a kind of menu governor which is compatible
	 with allwinner's soc which without perfect interrupts alignment ability,
	 will not use correction factor because the factor is not accurate for
	 predicting next interrupts.

config DT_IDLE_STATES
	bool

menu "ARM CPU Idle Drivers"
depends on ARM || ARM64
source "drivers/cpuidle/Kconfig.arm"
endmenu

menu "MIPS CPU Idle Drivers"
depends on MIPS
source "drivers/cpuidle/Kconfig.mips"
endmenu

menu "POWERPC CPU Idle Drivers"
depends on PPC
source "drivers/cpuidle/Kconfig.powerpc"
endmenu

endif

config ARCH_NEEDS_CPU_IDLE_COUPLED
	def_bool n
endmenu
```

## linux-sunxi/drivers/input/sensor/Kconfig
```kconfig
#
# sensor driver configuration
#
menuconfig INPUT_SENSOR
	bool "Sensors"
	help
	  Say Y here, and a list of supported sensor will be displayed.
	  This option doesn't affect the kernel.

	  If unsure, say Y.

if INPUT_SENSOR
config SENSORS_GPADC
        tristate "SUNXI GPADC"
        depends on INPUT_SENSOR
        default n
        help
          If you say yes here you get support for the gpadc collect analog input

endif
```

## linux-sunxi/drivers/input/touchscreen/gt5688/Kconfig
```kconfig
#
#  Touchscreen driver configuration
#
config  TOUCHSCREEN_GT5688
	tristate  "gt5688 touchscreen driver"
	#depends on INPUT && I2C
	default y
	help
	  Say Y here if you want to built-in gt5688 touchscreen.

	  If unsure, say N.

	  To compile this driver as a module, choose M here: the
	  module will be called gt5688.ko.


config  WAKEUP_BY_GT5688
	bool  "support gt5688 touchscreen to wakeup_src"
	depends on TOUCHSCREEN_GT5688 && PM_SLEEP
	default n
	help
	  Say Y here if you want to wake system up by gt5688.

	  If unsure, say N.
```

## linux-sunxi/drivers/input/touchscreen/s23501t0-g/Kconfig
```kconfig
#
#  Touchscreen driver configuration
#
config  TOUCHSCREEN_MSG2XXX
	tristate  "msg2xxx touchscreen driver"
	depends on INPUT && I2C
	default m
	help
	  Say Y here if you want to built-in msg2xxx touchscreen.

	  If unsure, say N.

	  To compile this driver as a module, choose M here: the
	  module will be called s23501to-g.ko.


config  WAKEUP_BY_MSG2XXX
	bool  "support msg2xxx touchscreen to wakeup_src"
	depends on TOUCHSCREEN_MSG2XXX && PM_SLEEP
	default n
	help
	  Say Y here if you want to wake system up by gt5688.

	  If unsure, say N.
```

## linux-sunxi/drivers/media/platform/sunxi-cve/Kconfig
```kconfig
#
# computer vision engine device configuration
#
config SUNXI_CVE
	tristate "CVE driver"
	default m
	---help---
	  This is the driver for allwinner platform computer vision engine(CVE) module.
	  To compile this driver as a module, choose M here: the
	  module will be called sunxi_cve.
```

## linux-sunxi/drivers/media/platform/sunxi-ise/Kconfig
```kconfig
#
# Platform drivers
# Most drivers here are currently for webcam support
# This is the driver for allwinner platform ISE module
#

config SUNXI_ISE
	tristate "ISE driver"
	default n
	---help---
	This is the driver for allwinner platform ISE module.
	To compile this driver as a module, choose M here: the
	module will be called sunxi_ise.
```

## linux-sunxi/drivers/media/platform/sunxi-vin/Kconfig
```kconfig
config CSI_VIN
	tristate "v4l2 new driver for SUNXI"
	default m
	select VIDEOBUF2_DMA_CONTIG

if CSI_VIN
source "drivers/media/platform/sunxi-vin/modules/sensor/Kconfig"
endif

config CCI
	tristate "use internal cci"
	default m
```

## linux-sunxi/drivers/media/platform/sunxi-vin/modules/sensor/Kconfig
```kconfig
config SENSOR_OV5640
	tristate "ov5640 sensor driver"
	default n

config SENSOR_OV2686
	tristate "ov2686 sensor driver"
	default n

config SENSOR_OV2710_AW6131
	tristate "ov2710_aw6131 sensor driver"
	default n

config SENSOR_OV2710_AW6131_CAMERA1
	tristate "ov2710_aw6131_camera1 driver"
	default n

config SENSOR_AR0238
	tristate "ar0238 sensor driver"
	default n

config SENSOR_IMX291_MIPI
	tristate "ima291_mipi sensor driver"
	default n

config SENSOR_IMX291_DVP
	tristate "imx291_dvp sensor driver"
	default n

config SENSOR_IMX317_MIPI
	tristate "imx317_mipi sensor driver"
	default n

config SENSOR_OV2718_MIPI
	tristate "ov2718_mipi sensor driver"
	default n

config SENSOR_MN34223_SLVDS
	tristate "mn34223_slvds sensor driver"
	default n

config SENSOR_IMX274_SLVDS
	tristate "imx274_slvds sensor driver"
	default n

config SENSOR_AR0238_HISPI
	tristate "ar0238_hispi sensor driver"
	default n

config SENSOR_IMX326_MIPI
	tristate "imx326_mipi sensor driver"
	default n
```

## linux-sunxi/drivers/pinctrl/sunxi/Kconfig
```kconfig
if ARCH_SUNXI
menu "Allwinner SOC PINCTRL DRIVER"

config PINCTRL_SUNXI_COMMON
	bool
	select PINMUX
	select GENERIC_PINCONF

config PINCTRL_SUNXI_TEST
	tristate "pinctrl sunxi test driver"

config PINCTRL_SUN4I_A10
	def_bool MACH_SUN4I
	select PINCTRL_SUNXI_COMMON

config PINCTRL_SUN5I_A10S
	def_bool MACH_SUN5I
	select PINCTRL_SUNXI_COMMON

config PINCTRL_SUN5I_A13
	def_bool MACH_SUN5I
	select PINCTRL_SUNXI_COMMON

config PINCTRL_SUN6I_A31
	def_bool MACH_SUN6I
	select PINCTRL_SUNXI_COMMON

config PINCTRL_SUN6I_A31S
	def_bool MACH_SUN6I
	select PINCTRL_SUNXI_COMMON

config PINCTRL_SUN6I_A31_R
	def_bool MACH_SUN6I
	depends on RESET_CONTROLLER
	select PINCTRL_SUNXI_COMMON

config PINCTRL_SUN7I_A20
	def_bool MACH_SUN7I
	select PINCTRL_SUNXI_COMMON

config PINCTRL_SUN8I_A23
	def_bool MACH_SUN8I
	select PINCTRL_SUNXI_COMMON

config PINCTRL_SUN8I_A33
	def_bool MACH_SUN8I
	select PINCTRL_SUNXI_COMMON

config PINCTRL_SUN8I_A83T
	def_bool MACH_SUN8I
	select PINCTRL_SUNXI_COMMON

config PINCTRL_SUN8I_A23_R
	def_bool MACH_SUN8I
	depends on RESET_CONTROLLER
	select PINCTRL_SUNXI_COMMON

config PINCTRL_SUN9I_A80
	def_bool MACH_SUN9I
	select PINCTRL_SUNXI_COMMON

config PINCTRL_SUN8IW7P1
	def_bool ARCH_SUN8IW7
	depends on ARCH_SUN8IW7
	bool "Pinctrl sun8iw7p1 PIO controller"
	select PINCTRL_SUNXI_COMMON

config PINCTRL_SUN8IW11P1
	def_bool ARCH_SUN8IW11
	depends on ARCH_SUN8IW11
	bool "Pinctrl sun8iw11p1 PIO controller"
	select PINCTRL_SUNXI_COMMON

config PINCTRL_SUN8IW7P1
	def_bool ARCH_SUN8IW7
	depends on ARCH_SUN8IW7
	bool "Pinctrl sun8iw7p1 PIO controller"
	select PINCTRL_SUNXI_COMMON

config PINCTRL_SUN8IW7P1_R
	def_bool PINCTRL_SUN8IW7P1
	depends on PINCTRL_SUN8IW7P1
	bool "Pinctrl PINCTRL_SUN8IW7P1 R_PIO controller"
	select PINCTRL_SUNXI_COMMON

config PINCTRL_SUN8IW12P1
	def_bool ARCH_SUN8IW12
	depends on ARCH_SUN8IW12
	bool "Pinctrl sun8iw12p1 PIO controller"
	select PINCTRL_SUNXI_COMMON

config PINCTRL_SUN8IW12P1_R
	def_bool PINCTRL_SUN8IW12P1
	depends on PINCTRL_SUN8IW12P1
	bool "Pinctrl PINCTRL_SUN8IW12P1 R_PIO controller"
	select PINCTRL_SUNXI_COMMON

config PINCTRL_SUN8IW15P1
	def_bool ARCH_SUN8IW15
	depends on ARCH_SUN8IW15
	bool "Pinctrl sun8iw15p1 PIO controller"
	select PINCTRL_SUNXI_COMMON

config PINCTRL_SUN8IW15P1_R
	def_bool PINCTRL_SUN8IW15P1
	depends on PINCTRL_SUN8IW15P1
	bool "Pinctrl PINCTRL_SUN8IW15P1 R_PIO controller"
	select PINCTRL_SUNXI_COMMON

endmenu
endif
```

## linux-sunxi/drivers/soc/box-standby/Kconfig
```kconfig
#
# Allwinner sunXi SoC drivers
#
config SUNXI_BOOTUP_EXTEND
       bool "support ir bootup feature"
       depends on SUNXI_ARISC && RTC_DRV_SUNXI
       default y
       help
         support ir bootup feature.
         but must has the module known as "ar100" or "cpus".
         the feature is support power up with ir when poweroff.
```

## linux-sunxi/drivers/video/fbdev/sunxi/Kconfig
```kconfig
#
# Video configuration for sunxi platform
#

menu "Video support for sunxi"
	depends on FB

config FB_CONSOLE_SUNXI
	bool "Framebuffer Console Support(sunxi)"
	select FB_CFB_FILLRECT
	select FB_CFB_COPYAREA
	select FB_CFB_IMAGEBLIT
	default n
	---help---
	  Frame buffer driver for sunxi based boards.

config DISP2_SUNXI
	tristate "DISP Driver Support(sunxi-disp2)"
	depends on (ARCH_SUNXI)
	default n
	---help---
	  Display driver for sunxi based boards.

source "drivers/video/fbdev/sunxi/disp2/disp/Kconfig"

config HDMI_DISP2_SUNXI
	tristate "HDMI Driver Support(sunxi-disp2)"
	depends on (DISP2_SUNXI)
	default n
	---help---
	  Hdmi driver for sunxi based boards.

config TV_DISP2_SUNXI
	 tristate "TV Driver Support(sunxi-disp2)"
	 depends on (DISP2_SUNXI)
	 default n
	 ---help---
	  TV driver for sunxi based boards.
config DISP2_TV_GM7121
	tristate "GM7121 TV module Support(sunxi-disp2)"
 	depends on (DISP2_SUNXI && TV_DISP2_SUNXI)
	default n
	---help---

config DISP2_TV_AC200
	tristate "AC200 TV module Support(sunxi-disp2)"
	depends on (DISP2_SUNXI && MFD_ACX00)
	default n
	---help---

config DISP2_SUNXI_BOOT_COLORBAR
	bool "boot colorbar Support for disp driver(sunxi-disp2)"
	depends on DISP2_SUNXI
	default n
	---help---
	  If true, the framebuffer will be filled by specified data
	  to display vertical colorbar.

config DISP2_SUNXI_DEBUG
	bool "debugfs support for disp driver(sunxi-disp2)"
	depends on DISP2_SUNXI
	default n
	---help---
	  This enable debugfs support for display driver. You can
	  get debug info or debug the driver via debugfs interface.

config DISP2_SUNXI_COMPOSER
	bool "composer support for disp driver(sunxi-disp2)"
	depends on DISP2_SUNXI
	default n
	---help---
	  This enable composer support for display driver. The composer
	  will serve hwc only.

config DISP2_SUNXI_COMPOSER2
	bool "composer2 support for disp driver(sunxi-disp2)"
	depends on DISP2_SUNXI
	default n
	---help---
	  This enable composer support for display driver. The composer
	  will serve hwc only.
endmenu
```

## linux-sunxi/drivers/video/fbdev/sunxi/disp2/disp/Kconfig
```kconfig
#
# Disp Engineer configuration for sunxi platform
#

menu "Disp Engineer support for sunxi"
	depends on DISP2_SUNXI

config DE_SUPPORT_SMBL
	bool "DispEngineer support smart backlight"
	default y
	---help---
		If you want to support smart backlight for display driver, set y.

config DE_SUPPORT_EINK
	bool "DispEngineer support eink screen"
	default y
	---help---
		If you want to support EINK Screen for display driver, select it.

config DE_SUPPORT_VGA
	bool "DispEngineer support vga"
	default y
	---help---
		If you want to support vga for display driver, select it.

config DE_SUPPORT_TV
	bool "DispEngineer support tv"
	default y
	---help---
		If you want to support vga for display driver, select it.

config DE_SUPPORT_ENHANCE
	bool "DispEngineer support enhance"
	default y
	---help---
		If you want to support enhance for display driver, select it.

menu "LCD panels select"
	depends on DISP2_SUNXI

source "drivers/video/fbdev/sunxi/disp2/disp/lcd/Kconfig"

endmenu

endmenu
```
