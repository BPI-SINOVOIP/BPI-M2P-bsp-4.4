## linux-sunxi/drivers/video/fbdev/sunxi/disp2/disp/lcd/Kconfig
```kconfig
config LCD_SUPPORT_CPU_GG1P4062UTSW
	bool "LCD support cpu_gg1p4062utsw panel"
	default y
	---help---
		If you want to support cpu_gg1p4062utsw panel for display driver, select it.

config LCD_SUPPORT_DX0960BE40A1
	bool "LCD support dx0960be40a1 panel"
	default y
	---help---
		If you want to support dx0960be40a1 panel for display driver, select it.

config LCD_SUPPORT_FD055HD003S
	bool "LCD support fd055hd003s panel"
	default y
	---help---
		If you want to support fd055hd003s panel for display driver, select it.

config LCD_SUPPORT_HE0801A068
	bool "LCD support he0801a068 panel"
	default y
	---help---
		If you want to support he0801a068 panel for display driver, select it.

config LCD_SUPPORT_ILI9341
	bool "LCD support ili9341 panel"
	default y
	---help---
		If you want to support ili9341 panel for display driver, select it.

config LCD_SUPPORT_LS029B3SX02
	bool "LCD support ls029b3sx02 panel"
	default y
	---help---
		If you want to support ls029b3sx02 panel for display driver, select it.

config LCD_SUPPORT_LT070ME05000
	bool "LCD support lt070me05000 panel"
	default y
	---help---
		If you want to support lt070me05000 panel for display driver, select it.


config LCD_SUPPORT_S6D7AA0X01
	bool "LCD support S6D7AA0X01 panel"
	default y
	---help---
		If you want to support S6D7AA0X01 panel for display driver, select it.


config LCD_SUPPORT_T27P06
	bool "LCD support t27p06 panel"
	default y
	---help---
		If you want to support t27p06 panel for display driver, select it.

config LCD_SUPPORT_TFT720x1280
	bool "LCD support tft720x1280 panel"
	default y
	---help---
		If you want to support tft720x1280 panel for display driver, select it.


config LCD_SUPPORT_WTQ05027D01
	bool "LCD support wtq05027d01 panel"
	default y
	---help---
		If you want to support wtq05027d01 panel for display driver, select it.
```

## linux-sunxi/modules/nand/Kconfig
```kconfig
menu "Sunxi nand support"

config SUNXI_NAND
	tristate  "The sunxi nand driver"
	default m
	help
	  The nand used on the platform.

endmenu
```

## linux-sunxi/sound/soc/sunxi/Kconfig
```kconfig
# Embedded Codec and Affiliated
config SND_SUNXI_SOC_RWFUNC
        bool

config SND_SUNXI_SOC_INTER_I2S
	bool

# CPU DAI module
config SND_SUNXI_SOC_CPUDAI
        bool

# HDMI Module
config SND_SUNXI_SOC_HDMI
        bool

# Digital Audio(I2S/PCM/TDM)
config SND_SUNXI_SOC_DAUDIO
        tristate

# SPDIF Audio Interface
config SND_SUNXI_SOC_SPDIF
        tristate

# DMIC Audio Interfacce
config SND_SUNXI_SOC_DMIC
	tristate

# SUNXI Platform DMA
config SND_SUNXI_SOC
        bool

# SUNXI Codec Embedded
config SND_SUN8IW7_CODEC
        bool

config SND_SUN8IW11_CODEC
        tristate

config SND_SUN8IW12_CODEC
	tristate

menu "Allwinner SoC Audio support"
# Card Machine Select
config SND_SUNXI_SOC_SUN8IW7_CODEC
        tristate "Allwinner Sun8iw7 Codec Support"
        select SND_SUNXI_SOC
        select SND_SOC_GENERIC_DMAENGINE_PCM
        select REGMAP_MMIO
        select SND_SUN8IW7_CODEC
        select SND_SUNXI_SOC_CPUDAI
        select SND_SUNXI_SOC_RWFUNC
	depends on ARCH_SUN8IW7
        help
          Select Y or M to add support for the Codec embedded in the Allwinner
          SUN8IW7 and affiliated SoCs.
					...
					...

config SND_SUNXI_SOC_SUN8IW11_CODEC
        tristate "Allwinner Sun8iw11 Codec Support"
        select SND_SUNXI_SOC
        select SND_SOC_GENERIC_DMAENGINE_PCM
        select REGMAP_MMIO
        select SND_SUN8IW11_CODEC
        select SND_SUNXI_SOC_CPUDAI
        select SND_SUNXI_SOC_RWFUNC
	depends on ARCH_SUN8IW11
        help
          Select Y or M to add support for the Codec embedded in the Allwinner
          SUN8IW11 and affiliated SoCs.

config SND_SUNXI_SOC_SUN8IW12_CODEC
        tristate "Allwinner Sun8iw12 Codec Support"
        select SND_SUNXI_SOC
        select SND_SOC_GENERIC_DMAENGINE_PCM
        select REGMAP_MMIO
        select SND_SUN8IW12_CODEC
        select SND_SUNXI_SOC_RWFUNC
	select SND_SUNXI_SOC_INTER_I2S
	depends on ARCH_SUN8IW12
        help
          Select Y or M to add support for the Codec embedded in the Allwinner
          SUN8IW12 and affiliated SoCs.

# HDMI Machine Select
config SND_SUNXI_SOC_SUNXI_HDMIAUDIO
        tristate "Allwinner HDMI Audio Support"
        select SND_SUNXI_SOC
        select SND_SOC_GENERIC_DMAENGINE_PCM
        select SND_SUNXI_SOC_DAUDIO
        select SND_SUNXI_SOC_HDMI
	select REGMAP_MMIO
        help
          Select Y or M to add support for the HDMI Audio Module in the Allwinner
          SoCs.

# Daudio Machine Select
config SND_SUNXI_SOC_SUNXI_DAUDIO
        tristate "Allwinner Digital Audio Support"
        select SND_SUNXI_SOC
        select SND_SOC_GENERIC_DMAENGINE_PCM
        select SND_SUNXI_SOC_DAUDIO
	select REGMAP_MMIO
        help
          Select Y or M to add support for I2S/PCM/TDM Module in the
          Allwinner SoCs.

# SPDIF Machine Select
config SND_SUNXI_SOC_SUNXI_SPDIF
        tristate "Allwinner SPDIF Support"
        select SND_SUNXI_SOC
        select SND_SOC_GENERIC_DMAENGINE_PCM
        select SND_SUNXI_SOC_SPDIF
	select REGMAP_MMIO
	depends on ARCH_SUN8IW11 || ARCH_SUN8IW7
        help
          Select Y or M to add support SPDIF Module in Allwinner
          SoCs.

# DMIC Machine Select
config SND_SUNXI_SOC_SUNXI_DMIC
	tristate "Allwinner DMIC Support"
	select SND_SUNXI_SOC
	select SND_SOC_GENERIC_DMAENGINE_PCM
	select SND_SUNXI_SOC_DMIC
	select REGMAP_MMIO
	select SND_SOC_DMIC
	depends on ARCH_SUN8IW12
	help
	  Select Y or M to add support DMIC Module in Allwinner
	  SoCs.


# SUNXI Debug Select
config SUNXI_AUDIO_DEBUG
	bool "Allwinner Audio Debug Support"
	depends on SND_SUNXI_SOC
	help
	  Select Y to enable debug information of allwinner audio driver
	  If you not sure, Just not select it.

endmenu
```
